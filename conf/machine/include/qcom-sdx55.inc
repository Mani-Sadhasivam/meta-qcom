## conf/machine/include/qcom-sdx55.inc
```bitbake
SOC_FAMILY = "sdx55"
require conf/machine/include/qcom-common.inc
require conf/machine/include/tune-cortexa7.inc

MACHINE_ESSENTIAL_EXTRA_RRECOMMENDS += " \
    qrtr \
    rmtfs \
"

# Android boot image settings
QCOM_BOOTIMG_PAGE_SIZE = "4096"
```

## conf/machine/sdx55-mtp.conf
```bitbake
#@TYPE: Machine
#@NAME: SDX55-MTP
#@DESCRIPTION: Machine configuration for the SDX55-MTP development board, with Qualcomm Snapdragon 865 SM8250.

require conf/machine/include/qcom-sdx55.inc

MACHINE_FEATURES = "usbhost usbgadget screen ext2"

KERNEL_IMAGETYPE ?= "Image.gz"
KERNEL_DEVICETREE ?= "qcom-sdx55-mtp.dtb"

SERIAL_CONSOLE ?= "115200 ttyMSM0"

"

PREFERRED_PROVIDER_virtual/kernel = "linux-linaro-qcomlt-dev"

# Use system partition for rootfs
QCOM_BOOTIMG_ROOTFS ?= "ubi0:system"
```
